## package/controllers/rocknix-joypad/Config.in
```kconfig
config BR2_PACKAGE_ROCKNIX_JOYPAD
	bool "rocxnix-joypad"
	  help
	    Alternative joypad control for handhelds from ROCXNIX
	    
	    https://github.com/ROCKNIX/rocknix-joypad
```

## package/modules/rtkbtusb/Config.in
```kconfig
config BR2_PACKAGE_RTKBTUSB
   bool "Realtek Bluetooth USB driver (rtk_btusb)"
   depends on BR2_LINUX_KERNEL
   help
     Build the Realtek USB‐only Bluetooth driver (rtk_btusb) out‐of‐tree
     against the Buildroot kernel, using the Radxa rtkbt GitHub repo.
```

## package/retroarch/shaders/sharp-shimmerless-shader/Config.in
```kconfig
config BR2_PACKAGE_SHARP_SHIMMERLESS_SHADER
        bool "sharp-shimmerless-shaders"
        help
          Sharp shimmerless shader for RetroArch.

	  https://github.com/Woohyun-Kang/Sharp-Shimmerless-Shader
```

## package/utils/xdelta3/Config.in
```kconfig
config BR2_PACKAGE_XDELTA3
	bool "xdelta3"
	help
	  Xdelta3 is a command-line tool and library for delta compression
	  using VCDIFF/RFC 3284 algorithms. It compresses the difference
	  between an old file and a new file, creating a small patch file
	  that can be used to recreate the new file from the old one.

	  This is particularly useful for binary file updates, firmware
	  patches, and reducing bandwidth requirements for file transfers.

	  http://xdelta.org/

if BR2_PACKAGE_XDELTA3

config BR2_PACKAGE_XDELTA3_LZMA
	bool "enable LZMA compression support"
	select BR2_PACKAGE_XZ
	help
	  Enable LZMA/XZ compression support in xdelta3.
	  This provides better compression ratios but requires
	  additional dependencies.

endif
```
