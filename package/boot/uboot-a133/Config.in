## package/boot/uboot-a133/Config.in
```kconfig
config BR2_PACKAGE_UBOOT_A133
    bool "uboot-a133"
    depends on BR2_aarch64
    help
      U-Boot boot packages for Allwinner A133-based handheld devices.
      
      This package builds boot_package.fex files for various A133 devices:
      - TrimUI Smart Pro, TrimUI Brick
      - Powkiddy V90S, V20
      - MagicX Zero 28, Zero 40
      - Xu20 V32
      
      Each device gets its device tree compiled and packed with U-Boot
      components using Allwinner's dragonsecboot tool.
      
      The resulting boot packages are placed in:
      output/images/a133-boot-packages/<device>_boot_package.fex
```

## package/boot/uboot-rk3566/Config.in
```kconfig
config BR2_PACKAGE_UBOOT_RK3566
    bool "uboot files for Rockchip RK3566"
    help
        uboot files for Rockchip RK3566
```

## package/cores/libretro-gametank/Config.in
```kconfig
config BR2_PACKAGE_LIBRETRO_GAMETANK
    bool "libretro-gametank"
    depends on BR2_PACKAGE_HOST_RUSTC_TARGET_ARCH_SUPPORTS
    select BR2_PACKAGE_HOST_RUSTC    
    depends on !BR2_STATIC_LIBS
    help
      GameTank libretro core.
      
      Emulates the GameTank fantasy console.
      A Rust-based libretro core.
      
      https://github.com/dwbrite/gametank_libretro

comment "libretro-gametank needs Rust toolchain, dynamic library"
    depends on !BR2_PACKAGE_HOST_RUST || BR2_STATIC_LIBS
```

## package/emulationstation/knulli-es-system/Config.in
```kconfig
config BR2_PACKAGE_KNULLI_ES_SYSTEM
        bool "knulli-es-system"
	select BR2_PACKAGE_KNULLI_CONFIGGEN
        help
          Generates the es_system.cfg file and the roms folder
```

## package/emulationstation/knulli-es-web-ui/Config.in
```kconfig
config BR2_PACKAGE_KNULLI_ES_WEB_UI
        bool "knulli Emulationstation Web UI"
	depends on BR2_PACKAGE_KNULLI_EMULATIONSTATION

        help
          A modern UI for ES web services
```

## package/gpu/mali-g57-sunxi/Config.in
```kconfig
config BR2_PACKAGE_MALI_G57_SUNXI
	bool "mali-g57-sunxi"
	depends on BR2_aarch64
	select BR2_PACKAGE_HAS_LIBEGL
	select BR2_PACKAGE_HAS_LIBGLES
	select BR2_PACKAGE_HAS_LIBMALI
	select BR2_PACKAGE_HAS_LIBOPENCL
	select BR2_PACKAGE_HAS_LIBVULKAN
	
	help
	  Install the binary user-space components for the MALI G57 (VALHALL) SUNXI 
	  GPU.

if BR2_PACKAGE_MALI_G57_SUNXI

config BR2_PACKAGE_PROVIDES_LIBEGL
	default "mali-g57-sunxi"

config BR2_PACKAGE_PROVIDES_LIBGLES
	default "mali-g57-sunxi"

config BR2_PACKAGE_PROVIDES_LIBMALI
	default "mali-g57-sunxi"

config BR2_PACKAGE_PROVIDES_LIBOPENCL
	default "mali-g57-sunxi"

endif

comment "mali-g57-sunxi"
```

## package/kernels/kernel-gammaos/Config.in
```kconfig
config BR2_PACKAGE_KERNEL_GAMMAOS
    bool "kernel-gammaos"
    help
      BSP kernel for the Miyoo Flip V2
```

## package/kernels/kernel-powkiddy-x55/Config.in
```kconfig
config BR2_PACKAGE_KERNEL_POWKIDDY_X55
    bool "kernel-powkiddy-x55"
    select BR2_PACKAGE_EXTRA_FIRMWARES
    help
      BSP kernel for the Powkiddy X55
```

## package/kernels/kernel-rg-ds/Config.in
```kconfig
config BR2_PACKAGE_KERNEL_RG_DS
    bool "kernel-rg-ds"
    select BR2_PACKAGE_EXTRA_FIRMWARES
    help
      BSP kernel RG DS (RK3568 based device)
```

## package/kernels/kernel-rk3566-bsp/Config.in
```kconfig
config BR2_PACKAGE_KERNEL_RK3566_BSP
    bool "kernel-rk3566-bsp"
    select BR2_PACKAGE_EXTRA_FIRMWARES
    help
      BSP kernel RK3566 based devices
```

## package/modules/vita-pro-modules/Config.in
```kconfig
config BR2_PACKAGE_VITA_PRO_MODULES
    bool "vita-pro-modules"
    depends on BR2_LINUX_KERNEL
    help
      Precompiled kernel modules for the RG Vita Pro joystick and touchscreen
```

## package/retroarch/shaders/knulli-shaders/Config.in
```kconfig
config BR2_PACKAGE_KNULLI_SHADERS
    bool "knulli shaders"
    select BR2_PACKAGE_COMMON_SHADERS
    select BR2_PACKAGE_GLSL_SHADERS
    select BR2_PACKAGE_SLANG_SHADERS
    help
      Batocera shaders for retroarch
```

## package/system/knulli-audio-alsa/Config.in
```kconfig
config BR2_PACKAGE_KNULLI_AUDIO_ALSA
	bool "knulli-audio"
	select BR2_PACKAGE_BLUEZ_ALSA	if !BR2_PACKAGE_KNULLI_TARGET_SUNXI_R16 && !BR2_PACKAGE_KNULLI_TARGET_ATM7039
	select BR2_PACKAGE_ALSA_UTILS
	select BR2_PACKAGE_ALSA_UTILS_AMIXER
	select BR2_PACKAGE_ALSA_UTILS_APLAY
	select BR2_PACKAGE_ALSA_PLUGINS
	help
	  Audio support and scripts for knulli.linux (ALSA)
```

## package/system/knulli-drminfo/Config.in
```kconfig
config BR2_PACKAGE_KNULLI_DRMINFO
       depends on BR2_PACKAGE_LIBDRM
       bool "knulli-drminfo"
```

## package/system/knulli-scripts/Config.in
```kconfig
config BR2_PACKAGE_KNULLI_SCRIPTS
	bool "knulli-scripts"

	select BR2_PACKAGE_BASH
	select BR2_PACKAGE_PCIUTILS
	select BR2_PACKAGE_PYTHON3
	select BR2_PACKAGE_DBUS_PYTHON                          # required for bluetooth scripts
	select BR2_PACKAGE_JQ # for vulkan parsing
	select BR2_PACKAGE_PYTHON_GOBJECT # for bluetooth agent

	help
	  Knulli scripts
```

## package/system/knulli-settings/Config.in
```kconfig
config BR2_PACKAGE_KNULLI_SETTINGS
	bool "knulli-settings"

	help
	  knulli-settings-get/set binaries
```

## package/system/knulli-splash/Config.in
```kconfig
config BR2_PACKAGE_KNULLI_SPLASH
    bool "knulli-splash"

    select BR2_PACKAGE_MPV           if BR2_PACKAGE_KNULLI_SPLASH_MPV
    select BR2_PACKAGE_LIBASS        if BR2_PACKAGE_KNULLI_SPLASH_MPV

    help
      Batocera splash

choice
        prompt "splash type"
        default BR2_PACKAGE_KNULLI_SPLASH_IMAGE
        help
          Select knulli.linux splash type

config BR2_PACKAGE_KNULLI_SPLASH_IMAGE
        bool "image"

config BR2_PACKAGE_KNULLI_SPLASH_MPV
        bool "mpv"

endchoice
```

## package/system/knulli-triggerhappy/Config.in
```kconfig
config BR2_PACKAGE_KNULLI_TRIGGERHAPPY
	bool "knulli-triggerhappy"

	select BR2_PACKAGE_TRIGGERHAPPY
```

## package/utils/allwinner-utils/Config.in
```kconfig
config BR2_PACKAGE_HOST_ALLWINNER_UTILS
    bool "host allwinner-utils"
    help
      Allwinner utilities for building boot images and environment.
      
      This package provides build tools for Allwinner platforms:
      - dragonsecboot: Tool for packing boot components into boot_package.fex
      - u_boot_env_gen: Tool for generating U-Boot environment partitions
      
      These are host tools used during the build process.
      
      https://github.com/knulli-cfw/hdzero-goggle-tools
```

## package/utils/drm-tool/Config.in
```kconfig
config BR2_PACKAGE_DRM_TOOL
    bool "drm-tool"
    depends on BR2_TOOLCHAIN_HAS_THREADS
    depends on !BR2_STATIC_LIBS
    select BR2_PACKAGE_LIBDRM
    help
      A simple tool for getting drm info and setting properties.
      
      Useful for debugging DRM/KMS display issues and configuring
      display properties from the command line.
      
      https://github.com/NickCis/drm_tool

comment "drm-tool needs a toolchain w/ threads, dynamic library"
    depends on !BR2_TOOLCHAIN_HAS_THREADS || BR2_STATIC_LIBS
    
```

## package/utils/silkyrgb/Config.in
```kconfig
config BR2_PACKAGE_SILKYRGB
    bool "silkyrgb"
	select BR2_PACKAGE_PYTHON3
    depends on !BR2_STATIC_LIBS
    help
      SilkyRGB by doughno
      
      https://github.com/chrizzo-hb/silky-rgb
```

## package/utils/vaixterm/Config.in
```kconfig
config BR2_PACKAGE_VAIXTERM
    bool "vaixterm"
    depends on BR2_PACKAGE_SDL2
    depends on BR2_TOOLCHAIN_HAS_THREADS
    depends on !BR2_STATIC_LIBS
    help
      VaixTerm is a simple terminal emulator based on SDL2.
      
      https://github.com/Stanley00/vaixterm

comment "vaixterm needs SDL2, toolchain w/ threads, dynamic library"
    depends on !BR2_PACKAGE_SDL2 || !BR2_TOOLCHAIN_HAS_THREADS || BR2_STATIC_LIBS
```
